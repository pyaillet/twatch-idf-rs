## sdkconfig.defaults
```kconfig
# Rust often needs a bit of an extra main task stack size compared to C (the default is 3K)
CONFIG_ESP_MAIN_TASK_STACK_SIZE=7000
CONFIG_ESP_SYSTEM_EVENT_TASK_STACK_SIZE=500

# Workaround for https://github.com/espressif/esp-idf/issues/7631
CONFIG_MBEDTLS_CERTIFICATE_BUNDLE=n
CONFIG_MBEDTLS_CERTIFICATE_BUNDLE_DEFAULT_FULL=n

CONFIG_ESP_EVENT_POST_FROM_ISR=y

#CONFIG_ESP_EVENT_LOOP_PROFILING=y

#CONFIG_LOG_DEFAULT_LEVEL=LOG_DEFAULT_LEVEL_DEBUG
#CONFIG_LOG_MAXIMUM_LEVEL=LOG_MAXIMUM_LEVEL_VERBOSE
#CONFIG_FREERTOS_CHECK_STACKOVERFLOW=FREERTOS_CHECK_STACKOVERFLOW_CANARY
```
